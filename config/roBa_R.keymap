#include "roBa_L.keymap"

#include "boards/shields/Test/roBa_R.overlay"
&trackball {
    automouse-layer = <MOUSE>;
    scroll-layers = <SCROLL>;
    arrows {
        layers = <6>;
        bindings =
            <&kp RIGHT_ARROW>,
            <&kp LEFT_ARROW>,
            <&kp UP_ARROW>,
            <&kp DOWN_ARROW>;

        tick = <10>;
        wait-ms = <5>;
        tap-ms = <5>;
    };
};
